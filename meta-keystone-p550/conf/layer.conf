## meta-keystone-p550/conf/layer.conf
```bitbake
BBPATH =. "${LAYERDIR}:"

BBFILES += "${LAYERDIR}/recipes-*/*/*.bb \
            ${LAYERDIR}/recipes-*/*/*.bbappend"

BBFILE_COLLECTIONS += "keystone-p550"
BBFILE_PATTERN_keystone-p550 = "^${LAYERDIR}/"
BBFILE_PRIORITY_keystone-p550 = "9"

LAYERVERSION_keystone-p550 = "1"
LAYERSERIES_COMPAT_keystone-p550 = "walnascar"
LAYERDEPENDS_keystone-p550 = "core meta-sifive"
```

## meta-keystone-p550/recipes-kernel/linux/files/keystone-driver/Kconfig
```kconfig
# SPDX-License-Identifier: GPL-2.0

config KEYSTONE_DRIVER
	tristate "Keystone enclave host driver"
	depends on RISCV
	help
	  Host-side Linux driver for Keystone enclaves. This copy is built from
	  the locked Keystone official VisionFive2 implementation and must match
	  the Security Monitor integrated into the P550 OpenSBI bootchain.
```
